/dts-v1/;
/plugin/;

/ {

    fragment@0 {

        // Overlay gets placed below toplevel node
        target-path = "/";

        __overlay__ {

            hw_timer_0: hw_timer_0 {
                // phandle of interrupt-parent (&gic)
                interrupt-parent = <0x4>;
                interrupts = <0 29 1>;
            };
        };
    };
};
